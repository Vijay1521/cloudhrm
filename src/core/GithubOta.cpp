#include "GithubOta.h"

#include <ArduinoJson.h>
#include <ESP8266HTTPClient.h>
#include <ESP8266httpUpdate.h>
#include <Updater_Signing.h>  // generated by the build: ARDUINO_SIGNING = 1 when public.key exists
#include <WiFiClientSecureBearSSL.h>
#include <time.h>

#include "../cloud/TrustAnchors.h"
#include "../config.h"
#include "../ui/Ui.h"
#include "Logger.h"
#include "Settings.h"

#ifndef ARDUINO_SIGNING
#define ARDUINO_SIGNING 0
#endif

namespace {

bool safeName(const String& s, size_t maxLen) {
  if (s.length() == 0 || s.length() > maxLen) return false;
  for (size_t i = 0; i < s.length(); i++) {
    char c = s[i];
    if (!isalnum((unsigned char)c) && c != '.' && c != '-' && c != '_') return false;
  }
  return true;
}

void prepare(BearSSL::WiFiClientSecure& tls) {
  tls.setTrustAnchors(TrustAnchors::get());
  tls.setX509Time(time(nullptr));
  tls.setTimeout(15000);
}

}  // namespace

bool GithubOta::configured() { return cfg::GITHUB_OTA_REPO[0] != 0; }
bool GithubOta::signedBuild() { return ARDUINO_SIGNING != 0; }
String GithubOta::repo() { return cfg::GITHUB_OTA_REPO; }

void GithubOta::begin(Settings& settings, Ui& ui) {
  s_ = &settings;
  ui_ = &ui;
  if (!configured()) {
    state_ = State::Disabled;
    error_ = "No GitHub repository set in config.h";
  } else if (!signedBuild()) {
    state_ = State::Disabled;
    error_ = "This firmware was built without public.key (unsigned)";
  } else {
    state_ = State::Idle;
  }
}

const char* GithubOta::stateName() const {
  switch (state_) {
    case State::Disabled: return "disabled";
    case State::Idle: return "idle";
    case State::Checking: return "checking";
    case State::UpToDate: return "up-to-date";
    case State::Available: return "available";
    case State::Installing: return "installing";
    case State::Failed: return "failed";
  }
  return "";
}

int GithubOta::compareVersions(const String& a, const String& b) {
  size_t ia = 0, ib = 0;
  while (ia < a.length() || ib < b.length()) {
    long na = 0, nb = 0;
    while (ia < a.length() && isdigit((unsigned char)a[ia])) na = na * 10 + (a[ia++] - '0');
    while (ib < b.length() && isdigit((unsigned char)b[ib])) nb = nb * 10 + (b[ib++] - '0');
    if (na != nb) return na < nb ? -1 : 1;
    if (ia < a.length()) ia++;  // skip '.'
    if (ib < b.length()) ib++;
  }
  return 0;
}

void GithubOta::fail(const String& why) {
  error_ = why;
  state_ = State::Failed;
  LOGW("GitHub update: %s", why.c_str());
}

void GithubOta::loop(bool online, bool idle, bool quiet) {
  if (rebootAt_ && (int32_t)(millis() - rebootAt_) >= 0) ESP.restart();
  if (state_ == State::Disabled) {
    wantCheck_ = wantInstall_ = false;
    return;
  }
  if (!online) return;

  if (wantCheck_) {
    wantCheck_ = false;
    checkNow();
  }
  if (wantInstall_) {
    wantInstall_ = false;
    if (state_ != State::Available) checkNow();
    if (state_ == State::Available) {
      if (idle) installNow();
      else fail("Terminal busy (enrollment running); try again");
    }
  }

  // Nightly auto-update: once a day, inside the window, only when idle.
  if (s_->flag(FLAG_AUTO_UPDATE) && idle && quiet && autoWindow()) {
    LOGI("GitHub update: nightly check");
    if (checkNow() && state_ == State::Available) installNow();
  }
}

bool GithubOta::autoWindow() {
  time_t now = time(nullptr);
  if (now < 1700000000) return false;
  struct tm t;
  localtime_r(&now, &t);
  // Spread devices over two hours so a fleet does not hit GitHub at once.
  int minuteOfWindow = (t.tm_hour - cfg::AUTO_UPDATE_HOUR) * 60 + t.tm_min;
  int slot = ESP.getChipId() % 120;
  if (minuteOfWindow < slot || minuteOfWindow >= 120) return false;
  if (t.tm_yday == lastAutoDay_) return false;
  lastAutoDay_ = t.tm_yday;
  return true;
}

bool GithubOta::checkNow() {
  if (time(nullptr) < 1700000000) {
    fail("Clock not synced yet (needed to check GitHub's certificate)");
    return false;
  }
  state_ = State::Checking;
  lastCheck_ = millis();
  String url = String("https://github.com/") + cfg::GITHUB_OTA_REPO + "/releases/latest/download/" +
               cfg::GITHUB_OTA_MANIFEST;

  BearSSL::WiFiClientSecure tls;
  prepare(tls);
  HTTPClient http;
  http.setFollowRedirects(HTTPC_STRICT_FOLLOW_REDIRECTS);
  http.setTimeout(15000);
  if (!http.begin(tls, url)) {
    fail("Bad manifest URL");
    return false;
  }
  int code = http.GET();
  String body = code == HTTP_CODE_OK ? http.getString() : String();
  http.end();
  tls.stop();
  if (code != HTTP_CODE_OK) {
    fail(code == 404 ? String("No release with manifest.json found")
                     : String("Manifest download failed: ") + (code > 0 ? String(code) : HTTPClient::errorToString(code)));
    return false;
  }

  JsonDocument doc;
  if (deserializeJson(doc, body) != DeserializationError::Ok) {
    fail("manifest.json is not valid JSON");
    return false;
  }
  String version = doc["version"] | "";
  String tag = doc["tag"] | "";
  String bin = doc["bin"] | "";
  uint32_t size = doc["size"] | 0;
  String md5 = doc["md5"] | "";
  if (!safeName(version, 20) || !safeName(tag, 40) || !safeName(bin, 64) || size == 0 || md5.length() != 32) {
    fail("manifest.json is missing fields or has invalid values");
    return false;
  }
  latest_ = version;
  if (compareVersions(version, CHRM_FW_VERSION) <= 0) {
    state_ = State::UpToDate;
    error_ = "";
    LOGI("GitHub update: %s is current (latest %s)", CHRM_FW_VERSION, version.c_str());
    return true;
  }
  if (size > ESP.getFreeSketchSpace()) {
    fail("New firmware is larger than the free OTA space");
    return false;
  }
  tag_ = tag;
  bin_ = bin;
  md5_ = md5;
  size_ = size;
  state_ = State::Available;
  error_ = "";
  LOGI("GitHub update: %s available", version.c_str());
  return true;
}

void GithubOta::installNow() {
  if (beforeInstall_) beforeInstall_();
  if (ESP.getFreeHeap() < 26000) {
    fail("Not enough free memory for the download; reboot and try again");
    return;
  }
  state_ = State::Installing;
  // Download from the same repository and release tag as the manifest.
  String url = String("https://github.com/") + cfg::GITHUB_OTA_REPO + "/releases/download/" + tag_ + "/" + bin_;
  LOGI("GitHub update: installing %s", latest_.c_str());
  ui_->progress("Updating", 0);

  BearSSL::WiFiClientSecure tls;
  prepare(tls);
  ESPhttpUpdate.rebootOnUpdate(false);
  ESPhttpUpdate.setFollowRedirects(HTTPC_FORCE_FOLLOW_REDIRECTS);  // GitHub redirects to its file CDN
  ESPhttpUpdate.setMD5sum(md5_);
  ESPhttpUpdate.setClientTimeout(15000);
  ESPhttpUpdate.onProgress([this](int done, int total) {
    static int last = -1;
    int pct = total > 0 ? (int)(done * 100LL / total) : 0;
    if (pct / 5 != last / 5) ui_->progress("Updating", pct);
    last = pct;
  });

  HTTPUpdateResult r = ESPhttpUpdate.update(tls, url, CHRM_FW_VERSION);
  tls.stop();
  if (r == HTTP_UPDATE_OK) {
    LOGI("GitHub update: %s installed, restarting", latest_.c_str());
    ui_->text2("Update", "done", 0);
    rebootAt_ = millis() + 1500;
    return;
  }
  ui_->text2("Update", "failed", 3000);
  fail("Install failed: " + ESPhttpUpdate.getLastErrorString());
}
